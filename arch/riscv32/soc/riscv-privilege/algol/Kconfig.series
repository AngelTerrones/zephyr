## arch/riscv32/soc/riscv-privilege/algol/Kconfig.series
```kconfig
config SOC_SERIES_RISCV32_ALGOL
       bool "RISC-V CPU implementation"
       depends on RISCV32
       select SOC_FAMILY_RISCV_PRIVILEGE
       help
       Enable support for Algol CPU
```

## boards/riscv/m2sf_algol/Kconfig.board
```kconfig
config BOARD_M2SF_ALGOL
       bool "Microsemi SmartFusion 2 dev board with the Algol CPU"
       depends on SOC_RISCV32_ALGOL
```

## boards/riscv32/m2sf_algol/m2sf_algol_defconfig
```kconfig
CONFIG_RISCV32=y
CONFIG_SOC_SERIES_RISCV32_ALGOL=y
CONFIG_SOC_RISCV32_ALGOL=y
CONFIG_BOARD_M2SF_ALGOL=y
CONFIG_CONSOLE=y
CONFIG_SERIAL=y
CONFIG_UART_ALGOL=y
CONFIG_UART_CONSOLE=y
CONFIG_UART_CONSOLE_ON_DEV_NAME="uart0"
CONFIG_PLIC=n
CONFIG_RISCV_MACHINE_TIMER=y
CONFIG_GPIO=n
CONFIG_BOOT_BANNER=y
CONFIG_XIP=y
```

## drivers/serial/Kconfig.algol
```kconfig
menuconfig UART_ALGOL
    bool "Algol UART driver"
    depends on SOC_RISCV32_ALGOL
    select SERIAL_HAS_DRIVER
    help
        Enable the UART driver.
```

## soc/riscv/riscv-privilege/algol/Kconfig.defconfig.series
```kconfig
if SOC_SERIES_RISCV32_ALGOL

config SOC_SERIES
       string
       default "algol"

config COMPILER_OPT
       string
       default "-march=rv32i -Os"

config SYS_CLOCK_HW_CYCLES_PER_SEC
       int
       default 100000000

config RISCV_SOC_INTERRUPT_INIT
       bool
       default y

config RISCV_HAS_CPU_IDLE
       bool
       default n

config RISCV_HAS_PLIC
       bool
       default n

config NUM_IRQS
       int
       default 16

config XIP
       bool
       default n

config RISCV_RAM_BASE_ADDR
       hex
       default 0x10005000

config RISCV_RAM_SIZE
       hex
       default 0x3000

config RISCV_ROM_BASE_ADDR
       hex
       default	0x10000000

config RISCV_ROM_SIZE
       hex
       default 0x5000

config RISCV_MACHINE_TIMER
    bool
    default y

config SYS_CLOCK_TICKS_PER_SEC
    int
    default 1000

config FORCE_NO_ASSERT
    bool
    default y

config ASSERT
    bool
    default n

endif # SOC_SERIES_RISCV32_ALGOL
```
